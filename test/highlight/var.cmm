Var.NEWGLOBAL char[4][32] \myarr
; <- keyword
;                          ^ variable
LOCAL &i &data

&data="zero|one|two|three"

&i=0.
WHILE &i<4
(
    PRIVATE &val
    &val=STRing.SPLIT("&data","|",&i)
    Var.Assign \myarr[&i]="&val"
    &i=&i+1.
)

Var.NEWLOCAL \x
; <- keyword
;             ^ variable
Var.set \x=func3(5,3)
PRINT Var.VALUE(\x)
