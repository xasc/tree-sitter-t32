PRIVATE &password
; <- keyword
;        ^ variable
ENTRY &password
; <- keyword
;        ^ parameter

IF "&password"==""
; <- conditional
;        ^ string
;             ^ operator
(
    ECHO "Failed to provide password."
    ENDDO
;   ^ keyword.return
)
ELSE
; <- conditional
(
    PRIVATE &pass

    &pass=FALSE()
;          ^ function.call
    WHILE !&pass
    (
        GOSUB verify_password "&password"
        RETURNVALUES &pass

        WAIT 1.ms
;            ^ number
    )
)

LOCAL &num

&num = 2.
;      ^ number

RePeaT &num PRINT "Password: &password"
ENDDO


verify_password:
; <- label
(
    PARAMETERS &password

    SYStem.Option.KEYCODE "&password"
    SYStem.Mode.Attach

    Data.Set EAXI:0x34000000 %Long 0x34000100 0x34000021 /verify
;            ^ number
;                            ^ constant.builtin
;                                                         ^ constant

    RETURN TRUE()
;   ^ keyword.return
)
