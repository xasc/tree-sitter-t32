PRIVATE &password
; <- keyword
;        ^ variable
ENTRY &password
; <- keyword
;        ^ parameter

IF "&password"==""
; <- conditional
;  ^ string
;    ^ parameter
;             ^ operator
(
    ECHO "Failed to provide password."
    ENDDO
;   ^ keyword.return
)
ELSE
; <- conditional
(
    PRIVATE &pass

    &pass=FALSE()
;          ^ function.call
    WHILE !&pass
;         ^ operator
    (
        GOSUB verify_password "&password"
;             ^ function.call
        RETURNVALUES &pass
;                     ^ parameter
        WAIT 10.ms
;            ^ number
    )

    IF !&pass
        GOTO fail
;            ^ label
    ELSE
    (
        GOSUB start_debug
;             ^ function.call
    )
)

LOCAL &num
;      ^ variable

&num = 2.
;      ^ number

RePeaT &num PRINT "Password: &password"
;       ^ variable
;                             ^ parameter

WinCLEAR
FramePOS ,,,,Maximized
;        ^ punctuation.delimiter
;            ^ constant
WinPOS 0% 50% 100% 35%
;      ^ number
COVerage.ListFunc

ENDDO


fail:
; <- label
    PRINT %ERROR "Password verification failed."
    END
;   ^ keyword.return


verify_password:
; <- function
(
    PARAMETERS &password
;               ^ parameter

    SYStem.Option.KEYCODE "&password"
    SYStem.JtagClock  1kHz
;                     ^ number
    SYStem.Mode.Attach

    Data.Set EAXI:0x34000000 %Long 0x34000100 0x34000021 /verify
;            ^ number
;                             ^ constant.builtin
;                                                         ^ constant

    RETURN TRUE()
;   ^ keyword.return
)


SUBROUTINE start_debug
;          ^ function
(
    Go main
    RETURN
;   ^ keyword.return
)

// vim: set ft=t32:
