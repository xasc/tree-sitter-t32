PRIVATE &password
; <- keyword
;        ^ variable.builtin
ENTRY &password
; <- keyword
;        ^ variable.parameter

IF "&password"==""
; <- conditional
;  ^ string
;    ^ variable.parameter
;             ^ operator
(
    ECHO "Failed to provide password."
    ENDDO
;   ^ keyword.return
)
ELSE
; <- conditional
(
    PRIVATE &pass

    &pass=FALSE()
;          ^ function.call
    WHILE !&pass
;         ^ operator
    (
        GOSUB verify_password "&password"
;             ^ function.call
        RETURNVALUES &pass
;                     ^ variable.parameter
        WAIT 10.ms
;            ^ number
    )

    IF !&pass
        GOTO fail
;            ^ label
    ELSE
    (
        GOSUB start_debug
;             ^ function.call
    )
)

LOCAL &num
;      ^ variable.builtin

&num = 2.
;      ^ number

RePeaT &num PRINT "Password: &password"
;       ^ variable.builtin
;                             ^ variable.parameter

WinCLEAR
FramePOS ,,,,Maximized
;        ^ punctuation.delimiter
;            ^ constant
WinPOS 0% 50% 100% 35%
;      ^ number
COVerage.ListFunc

ENDDO


fail:
; <- label
    PRINT %ERROR "Password verification failed."
    END
;   ^ keyword.return


verify_password:
; <- function
(
    PARAMETERS &password
;               ^ variable.parameter

    SYStem.Option.KEYCODE "&password"
    SYStem.JtagClock  1kHz
;                     ^ number
    SYStem.Mode.Attach

    Data.Set EAXI:0x34000000 %Long 0x34000100 0x34000021 /verify
;            ^ number
;                             ^ constant.builtin
;                                                         ^ constant

    RETURN TRUE()
;   ^ keyword.return
)


SUBROUTINE start_debug
;          ^ function
(
    Go main
    RETURN
;   ^ keyword.return
)

// vim: set ft=t32:
